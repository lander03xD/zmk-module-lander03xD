/*
 * Copyright (c) 2020 The ZMK Contributors
 *
 * SPDX-License-Identifier: MIT
 */


#include <dt-bindings/zmk/behaviors.h>
#include <dt-bindings/zmk/keys.h>

/ {
    behaviors {
#if ZMK_BEHAVIOR_OMIT(MORSE)
        /omit-if-no-ref/
#endif
        noise: noise_gen {
            compatible = "zmk,behavior-noise";
            #binding-cells = <0>;
            display-name = "Noise";
        };
    };
};

