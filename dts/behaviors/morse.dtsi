/*
 * Copyright (c) 2020 The ZMK Contributors
 *
 * SPDX-License-Identifier: MIT
 */


#include <dt-bindings/zmk/behaviors.h>
#include <dt-bindings/zmk/keys.h>

/ {
    behaviors {
#if ZMK_BEHAVIOR_OMIT(MORSE)
        /omit-if-no-ref/
#endif
        morse: grave_escape {
            compatible = "zmk,behavior-morse";
            #binding-cells = <0>;
            display-name = "Morse";
        };
    };
};

