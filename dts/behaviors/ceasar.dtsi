/*
 * Copyright (c) 2020 The ZMK Contributors
 *
 * SPDX-License-Identifier: MIT
 */


#include <dt-bindings/zmk/behaviors.h>
#include <dt-bindings/zmk/keys.h>

/ {
    behaviors {
        /omit-if-no-ref/ ceasar: ceasar_toggle {
            compatible = "zmk,behavior-ceasar";
            #binding-cells = <0>;
            display-name = "CeasarEncrypt";
        };
    };
};

