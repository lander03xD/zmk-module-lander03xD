## Kconfig
```kconfig
config ZMK_BEHAVIOR_MORSE
    bool
    default y
    depends on DT_HAS_ZMK_BEHAVIOR_MORSE_ENABLED

config ZMK_BEHAVIOR_CEASAR
    bool
    default y
    depends on DT_HAS_ZMK_BEHAVIOR_CEASAR_ENABLED

config ZMK_BEHAVIOR_NOISE
    bool
    default y
    depends on DT_HAS_ZMK_BEHAVIOR_NOISE_ENABLED
```

## dts/bindings/behaviors/zmk,behavior-ceasar.yaml
```yaml
# Copyright (c) 2020 The ZMK Contributors
# SPDX-License-Identifier: MIT

description: Ceasar Encryption Behavior

compatible: "zmk,behavior-ceasar"

include: zero_param.yaml # Additional parameters

properties: 
  rotation:
    type: int
    default: 17
```

## dts/bindings/behaviors/zmk,behavior-morse.yaml
```yaml
# Copyright (c) 2020 The ZMK Contributors
# SPDX-License-Identifier: MIT

description: Morse Code Behavior

compatible: "zmk,behavior-morse"

include: zero_param.yaml # Additional parameters

properties: 
  time-unit-ms:
    type: int
    required: true
```
